## conf/distro/arago-ezurio.conf
```bitbake
# Arago Ezurio Distro based on Arago Distro (meta-arago/meta-arago-distro/conf/disto/arago.conf)

require conf/distro/arago.conf

DISTRO_NAME = "Arago Ezurio"

PREFERRED_RPROVIDER_networkmanager = "summit-networkmanager-lwb-if"
PREFERRED_RPROVIDER_networkmanager-nmcli = "summit-networkmanager-lwb-if"
PREFERRED_RPROVIDER_wireless-regdb-static = "wireless-regdb"
PREFERRED_RPROVIDER_wpa-supplicant = "summit-supplicant-lwb-if"
PREFERRED_RPROVIDER_wpa-supplicant-cli = "summit-supplicant-lwb-if"
PREFERRED_RPROVIDER_wpa-supplicant-passphrase = "summit-supplicant-lwb-if"

# Install bootscript on boot partition
do_image_wic[depends] += "u-boot-script-ezurio:do_deploy"
IMAGE_BOOT_FILES += "boot.scr.uimg"
```

## conf/machine/carbon-am62-k3r5.conf
```bitbake
#@TYPE: Machine
#@NAME: Ezurio CarbonAM62 (R5F)
#@DESCRIPTION: Machine configuration for the Ezurio CarbonAM62 (R5F core)

require conf/machine/include/k3r5.inc
require conf/machine/include/ti-extras.inc

PREFERRED_PROVIDER_virtual/kernel = "linux-ti-ezurio"
PREFERRED_PROVIDER_u-boot = "u-boot-ti-ezurio"
PREFERRED_PROVIDER_virtual/bootloader = "u-boot-ti-ezurio"

SYSFW_SOC = "am62x"
SYSFW_CONFIG = "carbon"
SYSFW_SUFFIX = "hs-fs"

UBOOT_MACHINE = "carbon_am62_r5_defconfig"
```

## conf/machine/carbon-am62.conf
```bitbake
#@TYPE: Machine
#@NAME: Ezurio CarbonAM62
#@DESCRIPTION: Machine configuration for the Ezurio CarbonAM62

require conf/machine/include/am62xx.inc
require conf/machine/include/ti-extras.inc

PREFERRED_PROVIDER_virtual/kernel = "linux-ti-ezurio"
PREFERRED_PROVIDER_u-boot = "u-boot-ti-ezurio"
PREFERRED_PROVIDER_virtual/bootloader = "u-boot-ti-ezurio"

KERNEL_DEVICETREE_PREFIX = " \
    ti/k3-am625 \
    ti/k3-am62x-sk \
"

KERNEL_DEVICETREE = " \
    ti/k3-am625-sk.dtb \
"

UBOOT_MACHINE = "carbon_am62_a53_defconfig"

# Overwrite IMAGE_BOOT_FILES to use carbon naming
IMAGE_BOOT_FILES:remove = " tiboot3-am62x-hs-fs-evm.bin tiboot3-am62x-gp-evm.bin tiboot3-am62x-hs-evm.bin"
IMAGE_BOOT_FILES += "tiboot3-am62x-hs-fs-carbon.bin tiboot3-am62x-gp-carbon.bin tiboot3-am62x-hs-carbon.bin"
```
